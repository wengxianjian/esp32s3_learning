## code/main/Kconfig
```kconfig
menu "DNESP32S3 Learning Demo"

choice DEMO_RESOURCE
    prompt "Select resource demo to run"
    default DEMO_LED

config DEMO_LED
    bool "LED (GPIO output)"

config DEMO_KEY
    bool "KEY (GPIO input, press BOOT to toggle LED)"

config DEMO_EXIT
    bool "EXIT (GPIO external interrupt, press BOOT to toggle LED)"

config DEMO_UART
    bool "UART (serial echo + periodic message)"

config DEMO_ESPTIMER
    bool "ESPTimer (software timer, toggle LED)"

config DEMO_GPTIMER
    bool "GPTimer (hardware timer, toggle LED)"

config DEMO_WDT
    bool "Watchdog (task watchdog, feed then reset)"

config DEMO_SWPWM
    bool "SW PWM (software duty change, LED breathing)"

config DEMO_HWPWM
    bool "HW PWM (hardware fade, LED breathing)"

config DEMO_ADC
    bool "ADC (read voltage on GPIO8)"

config DEMO_RTC
    bool "RTC (set and read time)"

config DEMO_RNG
    bool "RNG (random number)"

config DEMO_TSENS
    bool "TSENS (internal temperature sensor)"

config DEMO_XL9555
    bool "I2C XL9555 (IO expander, toggle buzzer)"

config DEMO_EEPROM
    bool "I2C EEPROM (AT24C02, write + readback)"

config DEMO_OLED
    bool "I2C OLED (SSD1306, display text)"

config DEMO_AP3216C
    bool "I2C AP3216C (ALS/PS/IR sensor)"

config DEMO_QMA6100P
    bool "I2C QMA6100P (3-axis accelerometer)"
endchoice

endmenu
```

## code/sdkconfig.defaults
```kconfig
CONFIG_IDF_TARGET="esp32s3"
CONFIG_PARTITION_TABLE_CUSTOM=y
CONFIG_PARTITION_TABLE_CUSTOM_FILENAME="partitions.csv"
CONFIG_ESPTOOLPY_FLASHSIZE_16MB=y
CONFIG_ESPTOOLPY_FLASHMODE_DIO=y
# 使用原生 USB-Serial-JTAG 自动下载（免手动按键进下载模式）
CONFIG_ESPTOOLPY_BEFORE_USB_RESET=y
# 控制台日志走 USB-Serial-JTAG（烧录+日志同一根 USB）
CONFIG_ESP_CONSOLE_USB_SERIAL_JTAG=y
# 使用 legacy I2S API（与指南一致），屏蔽弃用告警
CONFIG_I2S_SUPPRESS_DEPRECATE_WARN=y
# TinyUSB MSC（模拟 U 盘）
CONFIG_TINYUSB_MSC_ENABLED=y
CONFIG_TINYUSB_MSC_BUFSIZE=4096
```
